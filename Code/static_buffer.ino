/* Edge Impulse ingestion SDK
 * Copyright (c) 2022 EdgeImpulse Inc.
 *
 * Licensed under the Apache License, Version 2.0 (the "License");
 * you may not use this file except in compliance with the License.
 * You may obtain a copy of the License at
 * http://www.apache.org/licenses/LICENSE-2.0
 *
 * Unless required by applicable law or agreed to in writing, software
 * distributed under the License is distributed on an "AS IS" BASIS,
 * WITHOUT WARRANTIES OR CONDITIONS OF ANY KIND, either express or implied.
 * See the License for the specific language governing permissions and
 * limitations under the License.
 *
 * Author Name: Jiajie Hao
 * 
 */

/* Includes ---------------------------------------------------------------- */
#include <fall_detection_and_alert_system_inferencing.h>
#include <Arduino_LSM9DS1.h>

#define EI_CLASSIFIER_FREQUENCY 62.5
#define BUZZER_PIN 2  // Define the pin for the buzzer

static float features[] = {
  // copy raw features here (for example from the 'Live classification' page)
  // see https://docs.edgeimpulse.com/docs/running-your-impulse-arduino
  -7.2323, -5.2349, 4.2066, 4.0894, 2.6245, -3.6011, -18.2129, 46.0571, 8.9966, -7.2036, -5.2511, 4.1881,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 8.3740
};

/**
 * @brief      Copy raw feature data in out_ptr
 *             Function called by inference library
 *
 * @param[in]  offset   The offset
 * @param[in]  length   The length
 * @param      out_ptr  The out pointer
 *
 * @return     0
 */
int raw_feature_get_data(size_t offset, size_t length, float *out_ptr) {
  memcpy(out_ptr, features + offset, length * sizeof(float));
  return 0;
}

void print_inference_result(ei_impulse_result_t result);

/**
 * @brief      Arduino setup function
 */
void setup() {
  // put your setup code here, to run once:
  Serial.begin(115200);
  // comment out the below line to cancel the wait for USB connection (needed for native USB)
  while (!Serial);

  if (!IMU.begin()) {
    Serial.println("IMU init failed!");
    while (1);
  }

  // Initialize the buzzer pin to the output mode
  pinMode(BUZZER_PIN, OUTPUT);

  Serial.println("Edge Impulse IMU-based pose detection\n");
}

/**
 * @brief      Arduino main function
 */
void loop() {
  //ei_printf("Edge Impulse standalone inferencing (Arduino)\n");

  // Remind users that it is start to collect data
  ei_printf("Starting data collection...\n");
  // Record the start time of data collection
  unsigned long start_time = millis();


  // Continuously read data (9 dimensions per frame) to fill the features array
  // the number of data: 9*62.5*2 = 1125
  for (int i = 0; i < 125; i++) {
    float ax, ay, az;
    float gx, gy, gz;
    float mx, my, mz;
    /*
    if (IMU.accelerationAvailable() && IMU.gyroscopeAvailable() && IMU.magneticFieldAvailable()) {
      IMU.readAcceleration(ax, ay, az);
      IMU.readGyroscope(gx, gy, gz);
      IMU.readMagneticField(mx, my, mz);

      features[i * 9 + 0] = ax;
      features[i * 9 + 1] = ay;
      features[i * 9 + 2] = az;
      features[i * 9 + 3] = gx;
      features[i * 9 + 4] = gy;
      features[i * 9 + 5] = gz;
      features[i * 9 + 6] = mx;
      features[i * 9 + 7] = my;
      features[i * 9 + 8] = mz;

      delay(1000 / EI_CLASSIFIER_FREQUENCY); 

    }*/
    // Make sure that all sensor data is ready
    while (!IMU.accelerationAvailable() || !IMU.gyroscopeAvailable() || !IMU.magneticFieldAvailable()) {
      delay(1); 
    }

    // read data from sensors
    IMU.readAcceleration(ax, ay, az);
    IMU.readGyroscope(gx, gy, gz);
    IMU.readMagneticField(mx, my, mz);

    // store data into the array
    features[i * 9 + 0] = ax;
    features[i * 9 + 1] = ay;
    features[i * 9 + 2] = az;
    features[i * 9 + 3] = gx;
    features[i * 9 + 4] = gy;
    features[i * 9 + 5] = gz;
    features[i * 9 + 6] = mx;
    features[i * 9 + 7] = my;
    features[i * 9 + 8] = mz;

    delay(1000 / EI_CLASSIFIER_FREQUENCY);  // Ensure that the sampling frequency is 62.5Hz
  }

  // Remind users that the data collection is completed
  ei_printf("Data collection complete.\n");
  // Record the time when the data collection ends
  unsigned long end_time = millis();
  // Calculate the time spent on data collection
  unsigned long collection_time = end_time - start_time;
  ei_printf("Data collection took %lu milliseconds.\n", collection_time);

  if (sizeof(features) / sizeof(float) != EI_CLASSIFIER_DSP_INPUT_FRAME_SIZE) {
    ei_printf("The size of your 'features' array is not correct. Expected %lu items, but had %lu\n",
              EI_CLASSIFIER_DSP_INPUT_FRAME_SIZE, sizeof(features) / sizeof(float));
    delay(1000);
    return;
  }

  ei_impulse_result_t result = { 0 };

  // the features are stored into flash, and we don't want to load everything into RAM
  signal_t features_signal;
  features_signal.total_length = sizeof(features) / sizeof(features[0]);
  features_signal.get_data = &raw_feature_get_data;

  // invoke the impulse
  EI_IMPULSE_ERROR res = run_classifier(&features_signal, &result, false /* debug */);
  if (res != EI_IMPULSE_OK) {
    ei_printf("ERR: Failed to run classifier (%d)\n", res);
    return;
  }

  // print inference return code
  //ei_printf("run_classifier returned: %d\r\n", res);
  print_inference_result(result);

  // Detect whether there is a fall
  if (result.classification[0].value > result.classification[1].value) {
    // If a fall occurs, the buzzer sounds for 3 seconds
    ei_printf("Fall detected! Activating buzzer for 3 seconds.\n");
    tone(BUZZER_PIN, 500);
    delay(3000);
    noTone(BUZZER_PIN);

    } else {
      // If you stand, do not react
      ei_printf("No fall detected. No action taken.\n");
      }

// Remind users that the inference is completed
  ei_printf("Inference complete. Waiting for next cycle...\n");

  delay(5000);// Make a complete posture judgment every five seconds
}

void print_inference_result(ei_impulse_result_t result) {

  ei_printf("Predictions:\r\n");
  for (uint16_t i = 0; i < EI_CLASSIFIER_LABEL_COUNT; i++) {
    ei_printf("  %s: ", ei_classifier_inferencing_categories[i]);
    ei_printf("%.5f\r\n", result.classification[i].value);
  }
}